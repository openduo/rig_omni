## poc/sdkconfig.defaults
```kconfig
# PoC 基础配置(不软链主工程,避免主工程的 LVGL/板型配置干扰)
# 只列 microlink PoC 真正需要的

# ★ 关键:显式声明 target,让 idf.py 第一次配置时知道用 xtensa 工具链
CONFIG_IDF_TARGET="esp32s3"

# 分区表(PoC 专用简单表,不是主工程的双 OTA)
CONFIG_PARTITION_TABLE_SINGLE_APP_LARGE=y

# mbedTLS(Noise/WireGuard 需要)
CONFIG_MBEDTLS_CHACHA20_C=y
CONFIG_MBEDTLS_POLY1305_C=y
CONFIG_MBEDTLS_CHACHAPOLY_C=y
CONFIG_MBEDTLS_HKDF_C=y
CONFIG_MBEDTLS_SSL_PROTO_TLS1_2=y
CONFIG_MBEDTLS_CERTIFICATE_BUNDLE=y

# WiFi 低延迟(microlink 要求关 AMPDU 降 WG 抖动)
CONFIG_ESP_WIFI_AMPDU_TX_ENABLED=n
CONFIG_ESP_WIFI_AMPDU_RX_ENABLED=n

# lwIP(WireGuard 隧道需要)
CONFIG_LWIP_IPV4=y
CONFIG_LWIP_IP4_FRAG=y
CONFIG_LWIP_IP4_REASSEMBLY=y
CONFIG_LWIP_MAX_SOCKETS=16
CONFIG_LWIP_TCPIP_RECVMBOX_SIZE=64
CONFIG_LWIP_TCP_SND_BUF_DEFAULT=32768
CONFIG_LWIP_TCP_WND_DEFAULT=32768

# FreeRTOS
CONFIG_FREERTOS_HZ=1000
CONFIG_ESP_MAIN_TASK_STACK_SIZE=8192

# WDT 放宽(Tailscale TLS 握手慢)
CONFIG_ESP_TASK_WDT_TIMEOUT_S=30

# 日志
CONFIG_LOG_DEFAULT_LEVEL_INFO=y
CONFIG_LOG_DEFAULT_LEVEL=3
```

## poc/sdkconfig.defaults.esp32s3
```kconfig
# ESP32-S3 硬件配置(PoC 专用)

# Flash
CONFIG_ESPTOOLPY_FLASHSIZE_16MB=y
CONFIG_ESPTOOLPY_FLASHMODE_QIO=y

# CPU
CONFIG_ESP_DEFAULT_CPU_FREQ_MHZ_240=y

# PSRAM(microlink 的 H2/JSON buffer 需要,默认各 128KB 见 local)
CONFIG_SPIRAM=y
CONFIG_SPIRAM_MODE_OCT=y
CONFIG_SPIRAM_SPEED_80M=y
CONFIG_SPIRAM_MALLOC_ALWAYSINTERNAL=4096
CONFIG_SPIRAM_MALLOC_RESERVE_INTERNAL=32768
CONFIG_SPIRAM_MEMTEST=n
CONFIG_MBEDTLS_EXTERNAL_MEM_ALLOC=y

# 缓存
CONFIG_ESP32S3_INSTRUCTION_CACHE_32KB=y
CONFIG_ESP32S3_DATA_CACHE_LINE_64B=y

# microlink buffer(小网络够用,与音频栈共存时省内存)
CONFIG_ML_H2_BUFFER_SIZE_KB=128
CONFIG_ML_JSON_BUFFER_SIZE_KB=128
CONFIG_ML_MAX_PEERS=4
```
